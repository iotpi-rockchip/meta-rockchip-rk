## conf/machine/firefly-rv1126-jd4.conf
```bitbake
# Copyright (c) 2022 Qingdao IotPi Information Technology Co., Ltd.

require conf/machine/include/rv1126.inc

KERNEL_DEVICETREE ?= "rv1126-firefly-jd4.dtb"
KBUILD_DEFCONFIG:firefly-rv1126-jd4 ?= "rv1126_firefly_defconfig"

# UBOOT_MACHINE ?= "rv1126-firefly-emmc-tb.config"
UBOOT_MACHINE ?= "rv1126_defconfig"
RK_TEE_ADDR ?= "0x08400000"

RK_WIFIBT_FIRMWARES = " \
	rkwifibt-firmware \
	brcm-tools \
"
```

## conf/machine/include/rv1126.inc
```bitbake
SOC_FAMILY ?= "rv1126"
require conf/machine/include/arm/armv7a/tune-cortexa7.inc
require conf/machine/include/rockchip-common.inc

PREFERRED_PROVIDER_virtual/kernel ?= "linux-rockchip-rv1126"
PREFERRED_VERSION_linux-rockchip-rv1126 = "4.19%"
LINUXLIBCVERSION = "4.19-custom%"

DEFAULTTUNE ?= "armv7ve-neon-vfpv4"
RK_ISP_VERSION := "1"
```
